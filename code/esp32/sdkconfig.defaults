## code/esp32/sdkconfig.defaults
```kconfig
# R4 device tier: fixed 240 MHz, -O2, benchmark alone on core 1.
CONFIG_IDF_TARGET="esp32"
CONFIG_COMPILER_OPTIMIZATION_PERF=y
CONFIG_ESP_DEFAULT_CPU_FREQ_MHZ_240=y
CONFIG_PM_ENABLE=n
CONFIG_FREERTOS_HZ=100
CONFIG_ESP_TASK_WDT_CHECK_IDLE_TASK_CPU1=n
CONFIG_ESP_INT_WDT_TIMEOUT_MS=1000
CONFIG_ESPTOOLPY_FLASHSIZE_4MB=y
CONFIG_MBEDTLS_HARDWARE_AES=y
CONFIG_ESP_CONSOLE_UART_BAUDRATE=115200
# ChaCha20-Poly1305 reference scheme (mbedTLS, software)
CONFIG_MBEDTLS_CHACHA20_C=y
CONFIG_MBEDTLS_POLY1305_C=y
CONFIG_MBEDTLS_CHACHAPOLY_C=y
```
